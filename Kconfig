## Kconfig
```kconfig
# Copyright (c) 2024 The ZMK Contributors
# SPDX-License-Identifier: MIT

config ZMK_WIDGET_KEYPRESS_ANIM
    bool "Keypress-driven animation, remotely triggered by the split central on every keypress"
    default n
    depends on ZMK_DISPLAY
```

## dts/bindings/behaviors/zmk,behavior-anim-pulse.yaml
```yaml
# Copyright (c) 2024 The ZMK Contributors
# SPDX-License-Identifier: MIT

description: |
  Peripheral-side keypress-animation pulse behavior. Not meant to be bound to
  a key in a keymap; it is invoked remotely by the split central whenever any
  key on either half of the split is pressed, so it can drive an animation on
  this half's display.

compatible: "zmk,behavior-anim-pulse"

include: zero_param.yaml
```
